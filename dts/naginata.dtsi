/*
 * Copyright (c) 2020 The ZMK Contributors
 *
 * SPDX-License-Identifier: MIT
 */

/ {
    behaviors {
        /omit-if-no-ref/ ng: naginata {
            compatible = "zmk,behavior-naginata";
            label = "NAGINATA";
            #binding-cells = <1>;
        };
    };
};
