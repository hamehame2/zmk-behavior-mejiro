## dts/bindings/behaviors/zmk,behavior-mejiro.yaml
```yaml
# SPDX-License-Identifier: MIT
description: Mejiro behavior (stub / placeholder)
compatible: "zmk,behavior-mejiro"

properties:
  "#binding-cells":
    const: 0
  label:
    type: string
    required: false
```
